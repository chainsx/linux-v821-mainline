## Documentation/devicetree/bindings/clock/allwinner,sun300i-v821-ccu.yaml
```yaml
# SPDX-License-Identifier: (GPL-2.0-only OR BSD-2-Clause)
%YAML 1.2
---
$id: http://devicetree.org/schemas/clock/allwinner,sun300i-v821-ccu.yaml#
$schema: http://devicetree.org/meta-schemas/core.yaml#

title: Allwinner V821 Application Clock Control Unit

maintainers:
  - ChainsX <chainsx@outlook.com>

properties:
  compatible:
    const: allwinner,sun300i-v821-app-ccu

  reg:
    maxItems: 1

  clocks:
    items:
      - description: High frequency oscillator
      - description: Fixed 192 MHz peripheral PLL output
      - description: Fixed 384 MHz peripheral PLL output

  clock-names:
    items:
      - const: hosc
      - const: pll-peri-192m
      - const: pll-peri-384m

  '#clock-cells':
    const: 1

  '#reset-cells':
    const: 1

required:
  - compatible
  - reg
  - clocks
  - clock-names
  - '#clock-cells'
  - '#reset-cells'

additionalProperties: false

examples:
  - |
    ccu: clock-controller@42001000 {
        compatible = "allwinner,sun300i-v821-app-ccu";
        reg = <0 0x42001000 0 0x100>;
        clocks = <&dcxo>, <&pll_peri_192m>, <&pll_peri_384m>;
        clock-names = "hosc", "pll-peri-192m", "pll-peri-384m";
        #clock-cells = <1>;
        #reset-cells = <1>;
    };
```

## Documentation/devicetree/bindings/mailbox/allwinner,sun300i-v821-msgbox.yaml
```yaml
# SPDX-License-Identifier: (GPL-2.0-only OR BSD-2-Clause)
%YAML 1.2
---
$id: http://devicetree.org/schemas/mailbox/allwinner,sun300i-v821-msgbox.yaml#
$schema: http://devicetree.org/meta-schemas/core.yaml#

title: Allwinner V821 Message Box

maintainers:
  - ChainsX <chainsx@outlook.com>

properties:
  compatible:
    const: allwinner,sun300i-v821-msgbox

  reg:
    items:
      - description: E907 message controller
      - description: A27 message controller

  reg-names:
    items:
      - const: remote
      - const: local

  interrupts:
    items:
      - description: E907 message controller interrupt
      - description: A27 message controller interrupt

  interrupt-names:
    items:
      - const: remote
      - const: local

  clocks:
    maxItems: 1

  resets:
    maxItems: 1

  '#mbox-cells':
    const: 1

required:
  - compatible
  - reg
  - reg-names
  - interrupts
  - interrupt-names
  - clocks
  - resets
  - '#mbox-cells'

additionalProperties: false

examples:
  - |
    mailbox@43033000 {
        compatible = "allwinner,sun300i-v821-msgbox";
        reg = <0 0x43033000 0 0x1000>,
              <0 0x49102000 0 0x1000>;
        reg-names = "remote", "local";
        interrupts = <0 130 4>, <0 123 4>;
        interrupt-names = "remote", "local";
        clocks = <&ccu 12>;
        resets = <&ccu 8>;
        #mbox-cells = <1>;
    };
```

## Documentation/devicetree/bindings/pinctrl/allwinner,sun300i-v821-pinctrl.yaml
```yaml
# SPDX-License-Identifier: (GPL-2.0-only OR BSD-2-Clause)
%YAML 1.2
---
$id: http://devicetree.org/schemas/pinctrl/allwinner,sun300i-v821-pinctrl.yaml#
$schema: http://devicetree.org/meta-schemas/core.yaml#

title: Allwinner V821 Pin Controllers

maintainers:
  - ChainsX <chainsx@outlook.com>

properties:
  compatible:
    enum:
      - allwinner,sun300i-v821-pinctrl
      - allwinner,sun300i-v821-r-pinctrl

  reg:
    maxItems: 1

  interrupts: true

  clocks: true

  clock-names: true

  gpio-controller: true

  '#gpio-cells':
    const: 3

  interrupt-controller: true

  '#interrupt-cells':
    const: 3

patternProperties:
  '-pins$':
    type: object
    additionalProperties: false

    properties:
      pins: true
      function: true
      bias-disable: true
      bias-pull-up: true
      bias-pull-down: true
      drive-strength:
        enum: [ 10, 20, 30, 40 ]

    required:
      - pins
      - function

required:
  - compatible
  - reg
  - interrupts
  - clocks
  - clock-names
  - gpio-controller
  - '#gpio-cells'
  - interrupt-controller
  - '#interrupt-cells'

additionalProperties: false

examples:
  - |
    pio: pinctrl@42000000 {
        compatible = "allwinner,sun300i-v821-pinctrl";
        reg = <0 0x42000000 0 0x500>;
        interrupts = <0 68 4>, <0 72 4>, <0 74 4>;
        clocks = <&pll_peri_192m>, <&dcxo>, <&losc>;
        clock-names = "apb", "hosc", "losc";
        gpio-controller;
        #gpio-cells = <3>;
        interrupt-controller;
        #interrupt-cells = <3>;
    };
```

## Documentation/devicetree/bindings/remoteproc/allwinner,sun300i-v821-rproc.yaml
```yaml
# SPDX-License-Identifier: (GPL-2.0-only OR BSD-2-Clause)
%YAML 1.2
---
$id: http://devicetree.org/schemas/remoteproc/allwinner,sun300i-v821-rproc.yaml#
$schema: http://devicetree.org/meta-schemas/core.yaml#

title: Allwinner V821 E907 Remoteproc

maintainers:
  - ChainsX <chainsx@outlook.com>

properties:
  compatible:
    const: allwinner,sun300i-v821-rproc

  reg:
    maxItems: 1

  allwinner,ccu:
    description: Phandle to the V821 CCU, used to access E907 reset controls.
    $ref: /schemas/types.yaml#/definitions/phandle

  firmware-name:
    $ref: /schemas/types.yaml#/definitions/string

  memory-region: true

  clocks:
    minItems: 3
    maxItems: 3

  clock-names:
    items:
      - const: core
      - const: gate
      - const: ts

  resets:
    minItems: 2
    maxItems: 2

  reset-names:
    items:
      - const: rv
      - const: apb

  mboxes:
    maxItems: 1

  mbox-names:
    items:
      - const: tx

required:
  - compatible
  - reg
  - allwinner,ccu
  - firmware-name
  - memory-region
  - clocks
  - clock-names
  - resets
  - reset-names
  - mboxes
  - mbox-names

additionalProperties: false

examples:
  - |
    remoteproc@43030000 {
        compatible = "allwinner,sun300i-v821-rproc";
        reg = <0 0x43030000 0 0x1000>;
        allwinner,ccu = <&ccu>;
        firmware-name = "amp_rv0.bin";
        memory-region = <&e907_mem>;
        clocks = <&e907_core>, <&ccu 14>, <&ccu 13>;
        clock-names = "core", "gate", "ts";
        resets = <&ccu 10>, <&ccu 9>;
        reset-names = "rv", "apb";
        mboxes = <&msgbox 0>;
        mbox-names = "tx";
    };
```

## Documentation/devicetree/bindings/rpmsg/allwinner,sun300i-v821-rpbuf.yaml
```yaml
# SPDX-License-Identifier: (GPL-2.0-only OR BSD-2-Clause)
%YAML 1.2
---
$id: http://devicetree.org/schemas/rpmsg/allwinner,sun300i-v821-rpbuf.yaml#
$schema: http://devicetree.org/meta-schemas/core.yaml#

title: Allwinner V821 Remote Processor Buffers

maintainers:
  - ChainsX <chainsx@outlook.com>

properties:
  compatible:
    enum:
      - allwinner,rpbuf-controller
      - allwinner,rpbuf-xradio

  remoteproc:
    $ref: /schemas/types.yaml#/definitions/phandle

  rpbuf:
    $ref: /schemas/types.yaml#/definitions/phandle

  memory-region: true

required:
  - compatible

allOf:
  - if:
      properties:
        compatible:
          const: allwinner,rpbuf-controller
    then:
      required:
        - remoteproc
        - memory-region
      properties:
        rpbuf: false
  - if:
      properties:
        compatible:
          const: allwinner,rpbuf-xradio
    then:
      required:
        - rpbuf
      properties:
        remoteproc: false
        memory-region: false

additionalProperties: false

examples:
  - |
    rpbuf-controller {
        compatible = "allwinner,rpbuf-controller";
        remoteproc = <&rproc>;
        memory-region = <&e907_mem>;
    };
```

## arch/riscv/configs/avaota_f1_defconfig
```kconfig
CONFIG_SYSVIPC=y
CONFIG_NO_HZ_IDLE=y
CONFIG_HIGH_RES_TIMERS=y
CONFIG_EXPERT=y
# CONFIG_VT is not set
# CONFIG_LEGACY_PTYS is not set
CONFIG_TMPFS=y
# CONFIG_BLK_DEV_LOOP is not set
CONFIG_BLK_DEV_INITRD=y
CONFIG_ARCH_SUNXI=y
CONFIG_NONPORTABLE=y
CONFIG_ARCH_RV32I=y
# CONFIG_EFI is not set
# CONFIG_STRICT_KERNEL_RWX is not set
CONFIG_MODULES=y
CONFIG_MODULE_UNLOAD=y
CONFIG_UNIX=y
CONFIG_INET=y
CONFIG_IPV6=y
CONFIG_PARTITION_ADVANCED=y
CONFIG_NET=y
CONFIG_PACKET=y
CONFIG_DEVTMPFS=y
CONFIG_DEVTMPFS_MOUNT=y
CONFIG_NETDEVICES=y
CONFIG_V821_FMAC_WLAN=m
CONFIG_AW_RPBUF_SERVICE_RPMSG=y
CONFIG_AW_RPBUF_CONTROLLER_SUNXI=y
CONFIG_SERIAL_8250=y
CONFIG_SERIAL_8250_CONSOLE=y
CONFIG_SERIAL_8250_DW=y
CONFIG_PINCTRL=y
# CONFIG_PINCTRL_SUN20I_D1 is not set
CONFIG_MMC=y
CONFIG_MMC_SUNXI=y
CONFIG_REMOTEPROC=y
CONFIG_SUN300I_V821_RPROC=m
CONFIG_RPMSG_VIRTIO=y
CONFIG_EXT4_FS=y
CONFIG_MSDOS_FS=y
CONFIG_VFAT_FS=y
CONFIG_NLS_CODEPAGE_437=y
CONFIG_NLS_ISO8859_1=y
CONFIG_PRINTK_TIME=y
CONFIG_DEBUG_FS=y
```

## drivers/net/wireless/allwinner/Kconfig
```kconfig
# SPDX-License-Identifier: GPL-2.0-only

menuconfig WLAN_VENDOR_ALLWINNER
	bool "Allwinner devices"
	default y
	help
	  If you have a wireless LAN card based on an Allwinner design, say Y.

if WLAN_VENDOR_ALLWINNER

source "drivers/net/wireless/allwinner/v821_fmac/Kconfig"

endif # WLAN_VENDOR_ALLWINNER
```

## drivers/net/wireless/allwinner/v821_fmac/Kconfig
```kconfig
# SPDX-License-Identifier: GPL-2.0-only

config V821_FMAC_WLAN
	tristate "Allwinner V821 XRADIO full MAC offload support"
	depends on NET && WLAN && RPMSG && AW_RPBUF
	help
	  Say Y or M here to enable the WiFi offload interface found on the
	  Allwinner V821. The 802.11 stack and MLME run on the E907 remote
	  processor; Linux exchanges control messages over rpmsg and packet
	  payload buffers over rpbuf. Two network interfaces are created for
	  concurrent STA and AP operation.
```

## drivers/rpbuf/Kconfig
```kconfig
# SPDX-License-Identifier: GPL-2.0-only

menu "Remote Processor Buffers"

config AW_RPBUF
	tristate
	help
	  This framework allocates large buffers and exchanges references to
	  them with remote processors.

config AW_RPBUF_SERVICE_RPMSG
	tristate "RPMsg-based RPBuf service"
	depends on RPMSG
	select AW_RPBUF
	help
	  Say Y or M here to use rpmsg as the control transport for RPBuf.

config AW_RPBUF_CONTROLLER_SUNXI
	tristate "Allwinner RPBuf controller"
	depends on AW_RPBUF_SERVICE_RPMSG
	help
	  Say Y or M here to support Allwinner reserved-memory RPBuf pools.

endmenu
```
